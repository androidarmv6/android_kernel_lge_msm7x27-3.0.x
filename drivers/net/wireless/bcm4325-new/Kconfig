## drivers/net/wireless/bcm4325-new/Kconfig
```kconfig
config BCM4325
	tristate "Broadcom 4325 wireless cards support"
	depends on MMC
	select WIRELESS_EXT
	select WEXT_PRIV
	---help---
	  This module adds support for wireless adapters based on
	  Broadcom 4329 chipset.

	  This driver uses the kernel's wireless extensions subsystem.

	  If you choose to build a module, it'll be called dhd. Say M if
	  unsure.

config BCM4325_FW_PATH
	depends on BCM4325
	string "Firmware path"
	default "/system/etc/firmware/fw_bcm4325.bin"
	---help---
	  Path to the firmware file.

config BCM4325_NVRAM_PATH
	depends on BCM4325
	string "NVRAM path"
	default "/proc/calibration"
	---help---
	  Path to the calibration file.
```
